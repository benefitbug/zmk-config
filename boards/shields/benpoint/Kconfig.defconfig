## boards/shields/benpoint/Kconfig.defconfig
```kconfig
if SHIELD_BENPOINT_RIGHT

# Name must be less than 16 characters long!
config ZMK_KEYBOARD_NAME
    default "BenPoint"

config ZMK_SPLIT_ROLE_CENTRAL
    default y

endif

if SHIELD_BENPOINT_LEFT || SHIELD_BENPOINT_RIGHT

config ZMK_SPLIT
    default y

endif
```

## boards/shields/benpoint/Kconfig.shield
```kconfig
# No whitespace after the comma or in your part name!
config SHIELD_BENPOINT_LEFT
    def_bool $(shields_list_contains,benpoint_left)

# No whitespace after the comma or in your part name!
config SHIELD_BENPOINT_RIGHT
    def_bool $(shields_list_contains,benpoint_right)
```

## config/west.yml
```yaml
manifest:
  remotes:
    - name: zmkfirmware
      url-base: https://github.com/zmkfirmware
    - name: infused-kim
      url-base: https://github.com/infused-kim
    - name: petejohanson
      url-base: https://github.com/petejohanson
    - name: urob
      url-base: https://github.com/urob
  projects:
    - name: zmk
      remote: zmkfirmware
      revision: main
      import: app/west.yml
  self:
    path: config
```
